## config/boards/shields/crosses_right_dongle_peripheral/Kconfig.defconfig
```kconfig
if SHIELD_CROSSES_RIGHT_DONGLE_PERIPHERAL

config ZMK_SPLIT
    default y

config ZMK_SPLIT_ROLE_CENTRAL
    default n

endif
```

## config/boards/shields/crosses_right_dongle_peripheral/Kconfig.shield
```kconfig
config SHIELD_CROSSES_RIGHT_DONGLE_PERIPHERAL
    def_bool $(shields_list_contains,crosses_right_dongle_peripheral)
```

## config/west.yml
```yaml
manifest:
  defaults:
    revision: main
  remotes:
    - name: zmkfirmware
      url-base: https://github.com/zmkfirmware
    - name: carrefinho
      url-base: https://github.com/carrefinho
    - name: Good-Great-Grand-Wonderful
      url-base: https://github.com/Good-Great-Grand-Wonderful
    - name: SolidAlloy
      url-base: https://github.com/SolidAlloy
    - name: efogdev
      url-base: https://github.com/efogdev
    - name: kot149
      url-base: https://github.com/kot149
    - name: oleksandrmaslov
      url-base: https://github.com/oleksandrmaslov
    - name: urob
      url-base: https://github.com/urob
  projects:
    - name: zmk
      remote: zmkfirmware
      revision: ac7f75b8591d39aaf3b66b9d26f26c9ed921a009
      import: app/west.yml
    - name: prospector-zmk-module
      remote: carrefinho
      revision: feat/new-status-screens
    - name: gggw-zmk-keebs
      remote: SolidAlloy
      revision: zephyr-4.1
      import: config/west.yml
    - name: zmk-pmw3610-driver
      remote: efogdev
      revision: f69a66dc2c19ee182f7212513a9a13c46d5dced9
    - name: zmk-scroll-snap
      remote: kot149
      revision: v1
    - name: zmk-pointing-acceleration
      remote: oleksandrmaslov
      revision: main
    - name: zmk-auto-layer
      remote: urob
      revision: main
  self:
    path: config
```
